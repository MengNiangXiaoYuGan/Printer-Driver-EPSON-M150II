## drivers/encode/Kconfig
```kconfig
config ENCODE_GPIO
    bool "encode use gpio"
    default n
    depends on GPIO
    depends on SENSOR
    help
        Enable sample encode for gpio support
```

## drivers/m150ii/Kconfig
```kconfig
menuconfig EPSON_M150II
	bool "epson m150ii micro dot printer"
	default n
	depends on GPIO && DISPLAY
	help
	"Enable epson m150ii printer support"
if EPSON_M150II

config PRINTER_FRAME_FORMAT_REVERSED
	bool "printer frame format reversed"
	default n
	help
	"Most devices use big-endian buffer layouts, 
	meaning the high-order byte is at the smaller coordinate position 
	(aligned along the X-axis in the byte direction). 
	If you need to switch to little-endian, 
	where the low-order byte is at the smaller coordinate position, 
	just turn on this option."

menuconfig M150II_PRINTER_CHARACTER
	bool "printer can printe character like printf or printk"
	default y
	help
	"Printers are meant for printing. Enabling this option will 
	additionally compile a function "m150_printf", which users 
	can use to treat the printer as a terminal to output characters. 
	More information can be found inside this list."

if M150II_PRINTER_CHARACTER
rsource "print_character/Kconfig"
endif

config PRINTER_PREDICTION_TIMING
	bool "printer timing use singel edge predict timing"
	default n
	help 
	"Enable this use active logic edge to predict mid timing,like
	                |-------------|                         |-------------|
	                |             |                         |             |
	----------------|             |-------------------------|             |-----
	rever singnal   simple time                             simple time
	                |---------|         |---------|         |---------|         |
	                |         |         |         |         |         |         |
	----------------|         |---------|         |---------|         |---------|
	predict signal  triger              triger              triger
	this option only use your timing detector wave not good but you wont to check
	program, actury, this option have to mach problam, if can do not use it"

choice "EPSON_M150II_LOG_LEVEL_CHOICE"
	prompt "Max compiled-in log level for Epson m150 ii micro dot printer"
	default EPSON_M150II_LOG_LEVEL_DEFAULT
	depends on LOG

config EPSON_M150II_LOG_LEVEL_NONE
	bool "none"

config EPSON_M150II_LOG_LEVEL_ERR
	bool "Error"

config EPSON_M150II_LOG_LEVEL_WRN
	bool "Warning"

config EPSON_M150II_LOG_LEVEL_INF
	bool "Info"

config EPSON_M150II_LOG_LEVEL_DBG
	bool "Debug"

config EPSON_M150II_LOG_LEVEL_DEFAULT
	bool "Default"

endchoice

config EPSON_M150II_LOG_LEVEL
	int
	depends on LOG
	default 0 if EPSON_M150II_LOG_LEVEL_NONE
	default 1 if EPSON_M150II_LOG_LEVEL_ERR
	default 2 if EPSON_M150II_LOG_LEVEL_WRN
	default 3 if EPSON_M150II_LOG_LEVEL_INF
	default 4 if EPSON_M150II_LOG_LEVEL_DBG
	default LOG_DEFAULT_LEVEL if EPSON_M150II_LOG_LEVEL_DEFAULT

endif
```

## drivers/m150ii/print_character/Kconfig
```kconfig
config M150II_USE_FONT_ASCII_5X7_FONT
	bool "use ascii 5x7 micro font"
	default y
	help
	"this is font of ASCII 32 (' ') to ASCII 126 ('~')
	beyond this edge code all display black squred"

config M150II_CHARACTER_BUFF_SIZE
	hex "printer character buff size"
	default 0x400
	range 0x10 0x10000000
	help
	"this option use for define character buff size
	if wont to printer more char once,
	may you use at list 0x1000(4k)
	most time default value is the best"
```

## dts/bindings/encode/zephyr,encode-gpio.yaml
```yaml
description: |
  Sensor driver for the relative-axis rotary encoder (gpio mode)

compatible: "zephyr,encode-gpio"

properties:
  a-gpios:
    type: phandle-array
    required: true
    description: A pin for the encoder
  b-gpios:
    type: phandle-array
    required: true
    description: B pin for the encoder
  ppr:
    type: int
    description: Pulse Per Revolution
    default: 11
    required: false
  spp:
    type: int
    description: |
        Number of steps (stable states) per period
        1: Full-period mode (default)
        2: Half-period mode
        4: Quarter-period mode
    required: false
    default: 1
  # polling-mode:
  #   type: bool
  #   description: |
  #       Do not use interrupt mode (default)
  #   required: false
```

## dts/bindings/printer/epson,m150ii.yaml
```yaml
description: |
  Printer device for the epson M-150II pin printer, use gpio

compatible: "epson,m150ii"

include: [base.yaml]
# include: [display-controller.yaml]

properties:
  reset-gpios:
    type: phandle-array
    required: true
    description: one line reste signal form gpio, use for enter an change line
  motor-gpios:
    type: phandle-array
    required: true
    description: motor control pin, set motor turn alound
  print-d-gpios:
    type: phandle-array
    required: true
    description: printer pin d,lasta stector
  print-c-gpios:
    type: phandle-array
    required: true
    description: printer pin c,3rd stector
  print-b-gpios:
    type: phandle-array
    required: true
    description: printer pin b,2nd stector
  print-a-gpios:
    type: phandle-array
    required: true
    description: printer pin a,first stector
  timing-gpios:
    type: phandle-array
    required: true
    description: printer timing signal, use for jage how time can set pin on and take point
  start-delay:
    type: int
    required: false
    default: 50
    description: when motor enable, delay this time for motor stable, ms
  zero-triger-delay:
    type: int
    required: false
    default: 20
    description: delay of enter to first dot when one line complete, if print thing too left ,add this value, right --, us
  
```
